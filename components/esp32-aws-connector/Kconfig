## components/esp32-aws-connector/Kconfig
```kconfig
menu "esp32-networking"

    menu "MQTT Config"

    config MQTT_NETWORK_BUFFER_SIZE
        int "Size of the network buffer for MQTT packets"
        range 1024 32000
        default 4096
        help
            Size of the network buffer for MQTT packets.

    config MQTT_TASK_STACK_SIZE
        int "MQTT client loop stack size"
        range 3052 8096
        default 4096
        help
            Stack size of MQTT task loop.

    config MQTT_TASK_PRIORITY
        int "Priority of MQTT task"
        range 1 9
        default 4
        help
            RTOS priority.

    config MQTT_ACK_TIMEOUT_MS
        int "Default timeout to wait for ACKs"
        range 1000 20000
        default 5000
        help
            Used to wait for for ACKs when issuing publish, subscribe, unsubscribe.

    endmenu # coreMQTT Config

    menu "BLE Provisioning"

    config BLE_WIFI_PROV_ENABLED
        bool "Enables WiFi provisioning over BLE"
        default y
        help
            Enable provisioning service

    config BLE_WIFI_PROV_CUSTOM_SERVICE_UUID_HIGH
        hex "High 64-bit service UUID for provisioning"
        default 0xFB4136D2F24B11ED
        help
            Sets the service UUID of the BLE service during provisioning.

    config BLE_WIFI_PROV_CUSTOM_SERVICE_UUID_LOW
        hex "Low 64-bit service UUID for provisioning"
        default 0xB2A5B6191059C7C3
        help
            Sets the service UUID of the BLE service during provisioning.

    endmenu # BLE Provisioning

endmenu # Golden Reference Integration 
```

## components/esp32-networking/Kconfig
```kconfig
menu "esp32-networking"

    menu "MQTT Config"

    config MQTT_NETWORK_BUFFER_SIZE
        int "Size of the network buffer for MQTT packets"
        range 1024 32000
        default 4096
        help
            Size of the network buffer for MQTT packets.

    config MQTT_TASK_STACK_SIZE
        int "MQTT client loop stack size"
        range 3052 8096
        default 4096
        help
            Stack size of MQTT task loop.

    config MQTT_TASK_PRIORITY
        int "Priority of MQTT task"
        range 1 9
        default 4
        help
            RTOS priority.

    config MQTT_ACK_TIMEOUT_MS
        int "Default timeout to wait for ACKs"
        range 1000 20000
        default 5000
        help
            Used to wait for for ACKs when issuing publish, subscribe, unsubscribe.

    endmenu # coreMQTT Config

endmenu # Golden Reference Integration 
```
